#include "snake.h"
#include "oled.h"
#include "rng.h"
#include "delay.h"
#include "timer.h"
/***************
已知bug 按得太快会原地撞向自己导致死亡
**********/
unsigned char raw_map[] =
{
0xFF,0x01,0x01,0x01,0x01,0x01,0x01,0x01,0x01,0x01,0x01,0x01,0x01,0x01,0x01,0x01,
0x01,0x01,0x01,0x01,0x01,0x01,0x01,0x01,0x01,0x01,0x01,0x01,0x01,0x01,0x01,0x01,
0x01,0x01,0x01,0x01,0x01,0x01,0x01,0x01,0x01,0x01,0x01,0x01,0x01,0x01,0x01,0x01,
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0x80,0x80,0x80,0x80,0x80,0x80,0x80,0x80,0x80,0x80,0x80,0x80,0x80,0x80,0x80,0xFF,
};
unsigned int snake[128]={0};
unsigned int food;
unsigned int snake_tail;
u8 first_in_flag=1;
u8 snake_len=1;

u8 direct=1;


void snak_init(void)
{
	u16 i=0;
	direct=1;
	flash_flag=0;
	snake_len=1;
	food = 0;
	snake_tail=0;
	for(i=0;i<1024;i++)
{
	map[i]=raw_map[i];
}
	for(i=0;i<128;i++)
	{
	snake[i]=0;
	}
	
	my_RNG_Init();
	delay_init();
	
	//蛇的位置
	snake[0]=(10+Get_RNG()%110)<<8;
	delay_us(10);
	snake[0] |=(5+Get_RNG()%50);
	
	//食物的位置
	food=(10+Get_RNG()%110)<<8;
	delay_us(10);
	food |=(5+Get_RNG()%50);
	
	showmap(raw_map);
	map_updata_snake(map,snake);
	map_updata_food(map,food);
	
	
	Tim3_Init(399,7199);
}

void food_flash(void)
{
	
	food=(10+Get_RNG()%110)<<8;
	delay_us(10);
	food |=(5+Get_RNG()%50);
	
	
	map_updata_food(map,food);
}

void snake_flash(u8 direct)
{

	u16 x,y,i=0;
	
	//获取蛇头位置
	x=snake[0]>>8;
	y=snake[0]<<8;
	y>>=8;
	
	//获取蛇尾位置
	while(snake[i+1]!=0)i++;
	snake_tail=snake[i];

	
	//判断运动方向
	if(direct==1)//右
	{
		x++;
	}
	else if(direct==2)
	{
		x--;
	}
	else if(direct==3)
	{
		y--;
	}
	else if(direct==4)
	{
		y++;
	}
	else;
	
	//更新蛇身位置
	while(i!=0)
	{	
		snake[i]=snake[i-1];
		i--;
	}
		
	//更新蛇头位置
	snake[0]= x<<8 | y;

	//判断死亡
	for(i=0;i<128;i++)
	{
	if((snake[0]>>8==127)|(snake[0]>>8==0)|((snake[0]&0x00FF)==0)|((snake[0]&0x00FF)==63))
	{
		snak_init();
		break;
	}
	if(snake[0]==snake[i+1])
	{
		snak_init();
		break;
	}
	}
	
	//如果吃到食物
	for(i=0;i<128;i++)
	{
	if(snake[i]==food)
	{
		food_flash();
		snake[snake_len]=snake_tail;
		snake_len++;
		snake_tail=0;
		break;
	}
}
	
	//更新地图
	map_updata_snake(map,snake);
}
void showmap(unsigned char* map)
{
	u16 i;
	for(i=0;i<128*8;i++){
	OLED_Set_Pos(i%128,i/128);
	OLED_WR_Byte(*map,OLED_DATA);
	map++;
	}
}

void map_updata_food(unsigned char* map,unsigned int food)
{
	u16 x,y;
	
	x=food>>8;
	y=food<<8;
	y>>=8;
	
	OLED_Set_Pos(x,y/8);
	x=x+128*(y/8);
	map[x]|=(1<<(y%8));
	OLED_WR_Byte(map[x],OLED_DATA);
	
}

void map_updata_snake(unsigned char* map,unsigned int* snake)
{
	u16 x,y;
	
	
	while(*snake!=0){
	x=*snake>>8;
	y=*snake<<8;
	y>>=8;
		
//	x=x+128*(y/8);
//	map[x]|=1<<(y%8);
	OLED_Set_Pos(x,y/8);
	x=x+128*(y/8);
	map[x]|=(1<<(y%8));
	OLED_WR_Byte(map[x],OLED_DATA);
		
	x=0;
	y=0;
	snake++;
	}
	if(snake_tail!=0)
	{
	x=snake_tail>>8;
	y=snake_tail<<8;
	y>>=8;
//	x=x+128*(y/8);
//	map[x]&=0xff^1<<(y%8);
	OLED_Set_Pos(x,y/8);
	x=x+128*(y/8);
	map[x]&=(0xff^1<<(y%8));
	OLED_WR_Byte(map[x],OLED_DATA);
	}		
}
unsigned char map[] =
{
0xFF,0x01,0x01,0x01,0x01,0x01,0x01,0x01,0x01,0x01,0x01,0x01,0x01,0x01,0x01,0x01,
0x01,0x01,0x01,0x01,0x01,0x01,0x01,0x01,0x01,0x01,0x01,0x01,0x01,0x01,0x01,0x01,
0x01,0x01,0x01,0x01,0x01,0x01,0x01,0x01,0x01,0x01,0x01,0x01,0x01,0x01,0x01,0x01,
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0x80,0x80,0x80,0x80,0x80,0x80,0x80,0x80,0x80,0x80,0x80,0x80,0x80,0x80,0x80,0xFF,
};
